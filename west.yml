## west.yml
```yaml
# Copyright (c) 2021 Teslabs Engineering S.L.
# SPDX-License-Identifier: Apache-2.0
# Requires Zephyr SDK 0.16.5

manifest:
  self:
    path: spinner

  remotes:
    - name: zephyr
      url-base: https://github.com/zephyrproject-rtos

  projects:
    - name: zephyr
      remote: zephyr
      repo-path: zephyr
      revision: v3.6.0
      import:
        name-allowlist:
          - cmsis
          - cmsis-dsp
          - hal_stm32
```
